#include "paj7620.h"
#include <stdio.h>
#include "esp_log.h"
#include "driver/i2c.h"

#define I2C_MASTER_TIMEOUT_MS       1000
#define I2C_MASTER_FREQ_HZ	1000000
/* Registers' initialization data */
unsigned char initRegisterArray[][2] = {	// Initial Gesture
    {0xEF,0x00},
	{0x32,0x29},
	{0x33,0x01},
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	{0x7E,0x01},
};

#define PAJ7620_TIMEOUT_MS_DEFAULT   (1000)


PAJ7620::PAJ7620(i2c_bus_handle_t bus, uint8_t dev_addr)
{
    m_paj7620 = (paj7620_dev_t *) calloc(1, sizeof(paj7620_dev_t));
    m_paj7620->i2c_dev = i2c_bus_device_create(bus, dev_addr, i2c_bus_get_current_clk_speed(bus));
    if (m_paj7620->i2c_dev == nullptr) {
        free(m_paj7620);
        m_paj7620 = nullptr;
    }
    m_paj7620->dev_addr = dev_addr;
    m_paj7620->timeout = PAJ7620_TIMEOUT_MS_DEFAULT;
}
/**************************************************************** 
 * Function Name: writeReg
 * Description:  PAJ7620 Write reg cmd
 * Parameters: addr:reg address; cmd:function data
 * Return: error code; success: return 0
****************************************************************/ 
uint8_t PAJ7620::writeReg(uint8_t addr, uint8_t cmd)
{
	return i2c_bus_write_byte(m_paj7620->i2c_dev, addr, cmd);
}

/**************************************************************** 
 * Function Name: readReg
 * Description:  PAJ7620 read reg data
 * Parameters: addr:reg address;
 *			   data_len:number of data to read, addr continuously increase;
 *			   data[]:storage memory start address
 * Return: error code; success: return 0
****************************************************************/ 
uint8_t PAJ7620::readReg(uint8_t addr, uint8_t data_len, uint8_t data[])
{
    return i2c_bus_read_bytes(m_paj7620->i2c_dev, addr, data_len, data);
}

/**************************************************************** 
 * Function Name: selectBank
 * Description:  PAJ7620 select register bank
 * Parameters: PAJ7620_BANK0, PAJ7620_BANK1
 * Return: none
****************************************************************/ 
void PAJ7620::selectBank(int bank)
{
    switch(bank){
		case PAJ7620_BANK0:
			writeReg(PAJ7620_REGITER_BANK_SEL, PAJ7620_BANK0);
			break;
		case PAJ7620_BANK1:
			writeReg(PAJ7620_REGITER_BANK_SEL, PAJ7620_BANK1);
			break;
		default:
			break;
	}
}

/****************************************************************
 * Function Name: paj7620Init
 * Description:  PAJ7620 REG INIT
 * Parameters: none
 * Return: error code; success: return 0
****************************************************************/ 
uint8_t PAJ7620::init(void) 
{
	//Near_normal_mode_V5_6.15mm_121017 for 940nm
	uint8_t error;
	uint8_t data0 = 0, data1 = 0;
	//wakeup the sensor
	vTaskDelay(1 / portTICK_PERIOD_MS);	//Wait 700us for PAJ7620U2 to stabilize

	ESP_LOGI("paj7620", "INIT SENSOR...");

	selectBank(PAJ7620_BANK0);
	selectBank(PAJ7620_BANK0);

	error = readReg(0, 1, &data0);
	if (error) {
		return error;
	}
	error = readReg(1, 1, &data1);
	if (error) {
		return error;
	}

	if ( (data0 != 0x20 ) || (data1 != 0x76) ) {
		return 0xff;
	}
	if ( data0 == 0x20 ) {
		ESP_LOGI("paj7620", "wake-up finish.");
	}
	
	for (int i = 0; i < INIT_REG_ARRAY_SIZE; i++) {
		writeReg(initRegisterArray[i][0], initRegisterArray[i][1]);
	}
	
	selectBank(PAJ7620_BANK0);  //gesture flage reg in PAJ7620_BANK0
	
	ESP_LOGI("paj7620", "Paj7620 initialize register finished.");
	return 0;
}

